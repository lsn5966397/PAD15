## boards/shields/Pad15/Kconfig.defconfig
```kconfig
# Copyright (c) 2020 The ZMK Contributors
# SPDX-License-Identifier: MIT

if SHIELD_PAD15

config ZMK_KEYBOARD_NAME
    default "Pad15"

endif
```

## boards/shields/Pad15/Kconfig.shield
```kconfig
# Copyright (c) 2020 The ZMK Contributors
# SPDX-License-Identifier: MIT

config SHIELD_PAD15
    def_bool $(shields_list_contains,Pad15)
source "$(ZMK_CONFIG)/modules/custom_led/Kconfig"
```

## config/Kconfig.shield
```kconfig
# Copyright (c) 2020 The ZMK Contributors
# SPDX-License-Identifier: MIT

config SHIELD_PAD15
    def_bool $(shields_list_contains,PAD15)
```

## config/boards/shields/pad15/Kconfig.defconfig
```kconfig
# Copyright (c) 2020 The ZMK Contributors
# SPDX-License-Identifier: MIT

if SHIELD_pad15

config ZMK_KEYBOARD_NAME
    default "pad15"

endif
```

## config/modules/custom_led/Kconfig
```kconfig
menu "Custom LED Module"

config CUSTOM_LED
    bool "Enable custom WS2812 LED animation for Pad15"
    default y
    depends on LED_STRIP          # ← 改成 depends on（不要用 select）
    help
      启用自定义 underglow 灯效线程（支持层指示、电池状态、休眠省电、效果切换等）。

endmenu
```

## config/modules/custom_led/zephyr/Kconfig
```kconfig
menu "Custom LED Module"

config CUSTOM_LED
    bool "Enable custom LED driver"
    default y
    help
      启用自定义 underglow 灯效线程（支持层指示、电池状态、休眠省电、效果切换等）。

endmenu
```

## config/west.yml
```yaml
manifest:
  remotes:
    # ZMK 官方主线仓库
    - name: zmkfirmware
      url-base: https://github.com/zmkfirmware

  projects:
    # 引入 ZMK 官方核心组件
    - name: zmk
      remote: zmkfirmware
      revision: main
      import: app/west.yml

  self:
    path: config
```

## dts/bindings/zmk,touch-slider.yaml
```yaml
description: Custom touch slider configuration
compatible: "zmk,touch-slider"
include: base.yaml
properties:
  pad-gpios:
    type: phandle-array
    required: true
    description: GPIO pins for the touch slider pads
```
